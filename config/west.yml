## config/west.yml
```yaml
manifest:
  defaults:
    revision: v0.3
  remotes:
    - name: zmkfirmware
      url-base: https://github.com/zmkfirmware
    - name: hitsmaxft
      url-base: https://github.com/hitsmaxft
    - name: urob
      url-base: https://github.com/urob
  projects:
    - name: zmk
      remote: zmkfirmware
      revision: main
      clone-depth: 1
      import: app/west.yml
    - name: zmk-keyboard-cornix
      remote: hitsmaxft
      revision: v2.7
      clone-depth: 1
    - name: zmk-helpers
      remote: urob
      revision: main
      clone-depth: 1
  self:
    path: config
```
